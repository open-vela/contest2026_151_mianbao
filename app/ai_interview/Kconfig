## app/ai_interview_test/Kconfig
```kconfig
#
# AI模拟面试官集成测试 Kconfig 配置
#

config APP_AI_INTERVIEW_TEST
	tristate "AI Interview Integration Test"
	default y
	---help---
		Enable the AI Interview integration test.
		This is a simple test to verify the build system
		integration works correctly.

if APP_AI_INTERVIEW_TEST

config APP_AI_INTERVIEW_TEST_PROGNAME
	string "Program name"
	default "ai_interview_test"
	---help---
		This is the name of the program for NSH.

config APP_AI_INTERVIEW_TEST_PRIORITY
	int "Task priority"
	default 100

config APP_AI_INTERVIEW_TEST_STACKSIZE
	int "Stack size"
	default 4096

endif
```

## app/button_test/Kconfig
```kconfig
#
# 按键 GPIO 测试程序 Kconfig 配置
#

config BUTTON_TEST
	tristate "Button GPIO Test"
	default y
	---help---
		Button GPIO test program to identify which GPIO pins control the buttons.
		Run this program to test GPIO0-GPIO5 and observe which pins
		change state when buttons are pressed.

if BUTTON_TEST

config BUTTON_TEST_PROGNAME
	string "Program name"
	default "button_test"
	---help---
		This is the name of the program for NSH.

config BUTTON_TEST_PRIORITY
	int "Task priority"
	default 100

config BUTTON_TEST_STACKSIZE
	int "Stack size"
	default 2048

endif
```

## app/led_test/Kconfig
```kconfig
#
# LED GPIO 测试程序 Kconfig 配置
#

config LED_TEST
	tristate "LED GPIO Test"
	default y
	---help---
		LED GPIO test program to identify which GPIO pins control the LEDs.
		Run this program to test GPIO0-GPIO19 and observe which pins
		control the LEDs on the board.

if LED_TEST

config LED_TEST_PROGNAME
	string "Program name"
	default "led_test"
	---help---
		This is the name of the program for NSH.

config LED_TEST_PRIORITY
	int "Task priority"
	default 100

config LED_TEST_STACKSIZE
	int "Stack size"
	default 2048

endif
```
